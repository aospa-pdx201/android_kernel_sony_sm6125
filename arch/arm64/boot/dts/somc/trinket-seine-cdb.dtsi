/* arch/arm64/boot/dts/somc/trinket-seine-cdb.dtsi
 *
 * This program is free software; you can redistribute it and/or modify
 * it under the terms of the GNU General Public License version 2 and
 * only version 2 as published by the Free Software Foundation.
 *
 * This program is distributed in the hope that it will be useful,
 * but WITHOUT ANY WARRANTY; without even the implied warranty of
 * MERCHANTABILITY or FITNESS FOR A PARTICULAR PURPOSE.  See the
 * GNU General Public License for more details.
 */
/*
 * Copyright 2018 Sony Corporation.
 *
 * This program is free software; you can redistribute it and/or modify
 * it under the terms of the GNU General Public License version 2, as
 * published by the Free Software Foundation.
 */

#include "trinket-seine-common.dtsi"

&soc {
};

#include "somc-seine-display.dtsi"
#include "somc-seine-display-cdb.dtsi"
#include "charger-seine-common.dtsi"
#include "charger-seine-cdb.dtsi"
