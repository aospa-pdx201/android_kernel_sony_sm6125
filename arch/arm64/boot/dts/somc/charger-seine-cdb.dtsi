/* Copyright (c) 2015-2018, The Linux Foundation. All rights reserved.
 *
 * This program is free software; you can redistribute it and/or modify
 * it under the terms of the GNU General Public License version 2 and
 * only version 2 as published by the Free Software Foundation.
 *
 * This program is distributed in the hope that it will be useful,
 * but WITHOUT ANY WARRANTY; without even the implied warranty of
 * MERCHANTABILITY or FITNESS FOR A PARTICULAR PURPOSE.  See the
 * GNU General Public License for more details.
 */
/*
 * Copyright 2019 Sony Corporation.
 *
 * This program is free software; you can redistribute it and/or modify
 * it under the terms of the GNU General Public License version 2, as
 * published by the Free Software Foundation.
 */

&pmi632_charger {
	qcom,fv-max-uv = <4350000>;
	qcom,chg-term-src = <1>;
	qcom,chg-term-current-ma = <(-173)>;
	somc,product-max-icl-ua = <3000000>;
};

&soc {
	seine_batterydata: qcom,battery-data {
		qcom,batt-id-range-pct = <17>;
		#include "qg-batterydata-seine-reference.dtsi"
	};
};

&pmi632_qg {
	qcom,battery-data = <&seine_batterydata>;
	qcom,qg-iterm-ma = <400>;
};
